/*
 * Description: ATMEGA32U4 defines and constants
 */


/* GPIO (use SBI/CBI) */
.EQU PORTF, 0x11
.EQU DDRF,  0x10
.EQU PINF,  0x0F

.EQU PORTE, 0x0E
.EQU DDRE,  0x0D
.EQU PINE,  0x0C

.EQU PORTD, 0x0B
.EQU DDRD,  0x0A
.EQU PIND,  0x09

.EQU PORTC, 0x08
.EQU DDRC,  0x07
.EQU PINC,  0x06

.EQU PORTB, 0x05
.EQU DDRB,  0x04
.EQU PINB,  0x03


/* System Clocks (use LDS/STS) */
.EQU CLKSEL0, 0xC5
.EQU RCSUT1, 7
.EQU RCSUT0, 6
.EQU EXSUT1, 5
.EQU EXSUT, 4
.EQU RCE, 3
.EQU EXTE, 2
.EQU CLKS, 0

.EQU CLKSEL1, 0xC6
.EQU RCCKSEL3, 7
.EQU RCCKSEL2, 6
.EQU RCCKSEL1, 5
.EQU RCCKSEL0, 4
.EQU EXCKSEL3, 3
.EQU EXCKSEL2, 2
.EQU EXCKSEL1, 1
.EQU EXCKSEL0, 0

.EQU CLKSTA, 0xC7
.EQU RCON, 1
.EQU EXTON, 0

.EQU CLKPR, 0x61
.EQU CLKPCE, 7
.EQU CLKPS3, 3
.EQU CLKPS2, 2
.EQU CLKPS1, 1
.EQU CLKPS0, 0

.EQU PLLCSR, 0x49
.EQU PINDIV, 4
.EQU PLLE, 1
.EQU PLOCK, 0

.EQU PLLFRQ, 0x52
.EQU PINMUX, 7
.EQU PLLUSB, 6
.EQU PLLTM1, 5
.EQU PLLTM0, 4
.EQU PDIV3, 3
.EQU PDIV2, 2
.EQU PDIV1, 1
.EQU PDIV0, 0


/* USB (use LDS/STS) */
.EQU UHWCON, 0xD7
.EQU UVREGE, 0

.EQU USBCON, 0xD8
.EQU USBE, 7
.EQU FRZCLK, 5
.EQU OTGPADE, 4
.EQU VBUSTE, 0

.EQU USBSTA, 0xD9
.EQU ID, 1
.EQU VBUS, 0

.EQU USBINT, 0xDA
.EQU VBUSTI, 0

.EQU UDCON, 0xE0
.EQU RSTCPU, 3
.EQU LSM, 2
.EQU RMWKUP, 1
.EQU DETACH, 0

.EQU UDINT, 0xE1
.EQU UPRSMI, 6
.EQU EORSMI, 5
.EQU WAKEUPI, 4
.EQU EORSTI, 3
.EQU SOFI, 2
.EQU SUSPI, 0

.EQU UDIEN, 0xE2
.EQU UPRSME, 6
.EQU EORSME, 5
.EQU WAKEUPE, 4
.EQU EORSTE, 3
.EQU SOFE, 2
.EQU SUSPE, 0

.EQU UDADDR, 0xE3
.EQU ADDEN, 7
.EQU UADD, 0

.EQU UDFNUMH, 0xE5
.EQU FNUMH, 0  /* FNUM Higher */

.EQU UDFNUML, 0xE4
.EQU FNUML, 0  /* FNUM Lower */

.EQU UDMFN, 0xE6
.EQU FNCERR, 4

.EQU UENUM, 0xE9
.EQU EPNUM, 0

.EQU UERST, 0xEA
.EQU EPRST, 0

.EQU UECONX, 0xEB
.EQU STALLRQ, 5
.EQU STALLRQC, 4
.EQU RSTDT, 3
.EQU EPEN, 0

.EQU UECFG0X, 0xEC
.EQU EPTYPE, 6
.EQU EPDIR, 0

.EQU UESTA0X, 0xEE
.EQU CFGOK, 7
.EQU OVERFI, 6
.EQU UNDERFI, 5
.EQU DTSEQ, 2
.EQU NBUSYBK, 0

.EQU UECFG1X, 0xED
.EQU EPSIZE, 4
.EQU EPBK, 2
.EQU ALLOC, 1

.EQU UESTA1X, 0xEF
.EQU CTRLDIR, 2
.EQU CURRBK, 0

.EQU UEINTX, 0xE8
.EQU FIFOCON, 7
.EQU NAKINI, 6
.EQU RWAL, 5
.EQU NAKOUTI, 4
.EQU RXSTPI, 3
.EQU RXOUTI, 2
.EQU STALLEDI, 1
.EQU TXINI, 0

.EQU UEIENX, 0xF0
.EQU FLERRE, 7
.EQU NAKINE, 6
.EQU NAKOUTE, 4
.EQU RXSTPE, 3
.EQU RXOUTE, 2
.EQU STALLEDE, 1
.EQU TXINE, 0

.EQU UEDATX, 0xF1
.EQU DATD, 0

.EQU UEBCHX, 0xF3
.EQU BYCTH, 0  /* BYCT Higher */

.EQU UEBCLX, 0xF2
.EQU BYCTL, 0  /* BYCT Lower */

.EQU UEINT, 0xF4
.EQU EPINT, 0
